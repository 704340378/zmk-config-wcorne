## config/Kconfig
```kconfig
#
# Copyright (c) 2022 The ZMK Contributors
# SPDX-License-Identifier: MIT
#

config BOARD_WCORNE_LEFT
    bool

config BOARD_WCORNE_RIGHT
    bool
```

## config/boards/arm/wcorne/Kconfig.board
```kconfig
#
# Copyright (c) 2022 Darryl deHaan
# SPDX-License-Identifier: MIT
#

config BOARD_WCORNE_LEFT
    bool "wcorne left"
    depends on SOC_NRF52840_QIAA


config BOARD_WCORNE_RIGHT
    bool "wcorne right"
    depends on SOC_NRF52840_QIAA
```

## config/boards/arm/wcorne/wcorne_left_defconfig
```kconfig
# SOC / Board — 这些由 shield/board 自动选，一般不用手写
# CONFIG_SOC_SERIES_NRF52X=y
# CONFIG_SOC_NRF52840_QIAA=y
# CONFIG_BOARD_WCORNE_LEFT=y





# pinctrl / GPIO（Zephyr 基本会自动选，留着也不算错）
CONFIG_PINCTRL=y
CONFIG_GPIO=y

# Flash 存储（给 settings / clear-bonds 等用）
CONFIG_USE_DT_CODE_PARTITION=y
CONFIG_FLASH=y
CONFIG_FLASH_PAGE_LAYOUT=y
CONFIG_FLASH_MAP=y
CONFIG_NVS=y
CONFIG_SETTINGS_NVS=y




# USB + BLE
CONFIG_ZMK_USB=y
CONFIG_ZMK_BLE=y

# ★ 把这三行也清掉 —— 没屏幕开 display 才会炸
 CONFIG_ZMK_DISPLAY=n

# EXT_POWER（你没有 OLED/外设供电的话也可以关，留着一般无害）
CONFIG_ZMK_EXT_POWER=n

# BLE
CONFIG_ZMK_BLE_PASSKEY_ENTRY=n
CONFIG_ZMK_BLE_CLEAR_BONDS_ON_START=n

CONFIG_USB_DEVICE_MANUFACTURER="wcorne"

CONFIG_BT_CTLR_TX_PWR_PLUS_8=y

# NKRO — 你写的是 n，等于已经关了，这行可以不写
# CONFIG_ZMK_HID_REPORT_TYPE_NKRO=n

# Mouse — 如果你没用到 mouse keys / pointing，可以关掉省空间
 CONFIG_ZMK_MOUSE=n
```

## config/boards/arm/wcorne/wcorne_right_defconfig
```kconfig
# =========================
# SoC / Board（由 shield 自动选择，不建议手写）
# =========================
# CONFIG_SOC_SERIES_NRF52X=y
# CONFIG_SOC_NRF52840_QIAA=y
# CONFIG_BOARD_WCORNE_RIGHT=y

CONFIG_ZMK_SLEEP=n

# =========================
# Flash / Settings
# =========================
CONFIG_ARM_MPU=y
CONFIG_MPU_ALLOW_FLASH_WRITE=y

CONFIG_USE_DT_CODE_PARTITION=y
CONFIG_BUILD_OUTPUT_UF2=y

CONFIG_FLASH=y
CONFIG_FLASH_PAGE_LAYOUT=y
CONFIG_FLASH_MAP=y
CONFIG_NVS=y
CONFIG_SETTINGS_NVS=y

# =========================
# Clock（nice_nano_v2 有外部 32k）
# =========================
CONFIG_CLOCK_CONTROL_NRF_K32SRC_XTAL=y
CONFIG_CLOCK_CONTROL_NRF_K32SRC_30PPM=y

# =========================
# USB / BLE
# =========================
CONFIG_ZMK_USB=n          # ✅ 右半不接 USB，正确
CONFIG_ZMK_BLE=y

CONFIG_ZMK_BLE_PASSKEY_ENTRY=n
CONFIG_ZMK_BLE_CLEAR_BONDS_ON_START=n

CONFIG_USB_DEVICE_MANUFACTURER="wcorne"

CONFIG_BT_CTLR_TX_PWR_PLUS_8=y

# =========================
# Zephyr 基础
# =========================
CONFIG_PINCTRL=y
CONFIG_GPIO=y

# =========================
# 明确关闭你不用的功能（关键）
# =========================
# CONFIG_ZMK_DISPLAY is not set        # ✅ 关掉，没有屏幕
# CONFIG_ZMK_EXT_POWER is not set      # ✅ 没 OLED/外设供电就关
# CONFIG_ZMK_MOUSE is not set          # ✅ 没滚轮/轨迹球就关
# CONFIG_ZMK_HID_REPORT_TYPE_NKRO is not set
```
